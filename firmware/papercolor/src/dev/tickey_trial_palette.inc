// Generated from sf32rc/v2/gallery/tickey-palette.json; TICKEY2.1.0 original palette.
// Firmware SHA256: 519fe0e3c585db7d4e7f84870ba44c12b4bef3daf145f23bb4d9fea4811c82c3
// RGB references are source encodings, not measured PaperColor optical colors.
static constexpr PaletteEntry fast_palette[] = {
    {3, 30, 25, 47},
    {4, 62, 37, 56},
    {5, 108, 62, 72},
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    {63, 219, 198, 57},
};
static constexpr PaletteEntry quality_palette[] = {
    {3, 31, 25, 43},
    {4, 46, 33, 55},
    {5, 64, 46, 66},
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    {60, 243, 214, 7},
};
